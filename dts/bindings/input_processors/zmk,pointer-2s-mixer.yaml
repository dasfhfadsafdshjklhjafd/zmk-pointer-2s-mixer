## dts/bindings/input_processors/zmk,pointer-2s-mixer.yaml
```yaml
description: Input Processor for mixing readings from two mouse sensors
compatible: "zmk,pointer-2s-mixer"
include: ip_one_param.yaml

properties:
  sync-report-ms:
    type: int
    required: true
    default: 2
  sync-scroll-report-ms:
    type: int
    required: true
    default: 8

  # CPI and sync-scroll-report-ms dependent!
  # Smaller value = less wiggle allowed
  twist-interference-thres:
    type: int
    required: true
    default: 200
  twist-interference-window:
    type: int
    default: 100
    deprecated: true

  # CPI and sync-scroll-report-ms dependent!
  # Filters out twist movements smaller than N points
  twist-thres:
    type: int
    required: true
    default: 4

  # Zero = down left bottom (NOT BALL CENTER)
  sensor1-pos:
    type: uint8-array
    required: true
    default: [ (0), (80), (0) ]
  sensor2-pos:
    type: uint8-array
    required: true
    default: [ (ff), (80), (0) ]
  ball-radius:
    type: int
    required: true
    default: 120

  feedback-gpios:
    type: phandle-array
  feedback-extra-gpios:
    type: phandle-array
  twist-feedback-threshold:
    type: int
    default: 100
  twist-feedback-duration:
    type: int
    default: 0
  twist-feedback-delay:
    type: int
    default: 5

  single-sensor-mode:
    type: boolean
    description: Enable single-sensor fallback behavior.
  single-sensor-primary:
    type: int
    description: Which sensor (1 or 2) is kept active in single-sensor mode.
    enum:
      - 1
      - 2
  single-sensor-transform:
    type: array
    description: >
      Fixed 2x2 transform matrix (a b c d) encoded as integers where 1000 == 1.0.
```
